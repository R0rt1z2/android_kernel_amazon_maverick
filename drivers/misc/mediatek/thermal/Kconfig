## drivers/misc/mediatek/thermal/Kconfig
```kconfig
config MTK_THERMAL_PA_VIA_ATCMD
	bool "Thermal switch for query modem RF temp"
	help
	  Internal switch for thermal management
	  to query modem RF temperature
	  via AT command.
	  (RIL sockets)

config VS_BACKLIGHT_COOLER
	bool "Virtual Sensor backlight cooler"
	default n

config VS_BCCT_COOLER
	bool "Virtual Sensor battery current cooler"
	default n
```
